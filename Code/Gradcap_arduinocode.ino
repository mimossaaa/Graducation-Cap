// ESP32_Arduino_for_Uno.ino
// Expert embedded-systems solution for Arduino Uno R3 and I2C LCD.

// Required Libraries:
// 1. Wire.h: For I2C communication. This library is pre-installed with the Arduino IDE.
// 2. LiquidCrystal_I2C.h: For controlling I2C LCDs.
//    To install: Open Arduino IDE -> Sketch -> Include Library -> Manage Libraries...
//    Search for "LiquidCrystal I2C" by Frank de Brabander (or a similar popular one) and install it.

#include <Wire.h>             // Include the I2C communication library
#include <LiquidCrystal_I2C.h> // Include the LCD I2C library

// --- Configuration Definitions ---
const int LCD_COLS = 20;     // Number of columns on the LCD (e.g., 16, 20)
const int LCD_ROWS = 4;      // Number of rows on the LCD (e.g., 2, 4)
const int LCD_ADDRESS = 0x3F; // I2C address of the LCD module. Common addresses are 0x27 or 0x3F.
                              // If your LCD doesn't work, try changing this address.

// --- I2C Pin Definitions for Arduino Uno R3 ---
// For Arduino Uno R3, SDA (Serial Data Line) is on Analog Pin 4 (A4)
// and SCL (Serial Clock Line) is on Analog Pin 5 (A5).
// The Wire library automatically uses these default pins.

// --- Custom Character Definitions for "Cal bound" ---
// These byte arrays are generated by the companion Python script 'generate_lcd_chars.py'.
// Each array defines a 5x8 pixel pattern. The 5 least significant bits represent the pixels.
// A '1' bit means the pixel is ON, '0' means OFF.
//
// These are the characters you provided:
// (Mapping: C, A, L, space, B, O, U, N)
byte custom0[8] = { 0b01110, 0b10000, 0b10000, 0b10000, 0b01110, 0b00000, 0b00000, 0b00000 }; // Looks like 'C'
byte custom1[8] = { 0b01110, 0b10001, 0b11111, 0b10001, 0b10001, 0b00000, 0b00000, 0b00000 }; // Looks like 'A'
byte custom2[8] = { 0b10000, 0b10000, 0b10000, 0b10000, 0b11111, 0b00000, 0b00000, 0b00000 }; // Looks like 'L'
byte custom3[8] = { 0b00000, 0b00000, 0b00000, 0b00000, 0b00000, 0b00000, 0b00000, 0b00000 }; // Looks like ' ' (Space)
byte custom4[8] = { 0b11110, 0b10001, 0b11110, 0b10001, 0b11110, 0b00000, 0b00000, 0b00000 }; // Looks like 'B'
byte custom5[8] = { 0b01110, 0b10001, 0b10001, 0b10001, 0b01110, 0b00000, 0b00000, 0b00000 }; // Looks like 'O'
byte custom6[8] = { 0b10001, 0b10001, 0b10001, 0b10001, 0b01110, 0b00000, 0b00000, 0b00000 }; // Looks like 'U'
byte custom7[8] = { 0b10001, 0b11001, 0b10101, 0b10011, 0b10001, 0b00000, 0b00000, 0b00000 }; // Looks like 'N'

// --- LCD Object Initialization ---
// Create an LCD object with the specified I2C address, columns, and rows.
LiquidCrystal_I2C lcd(LCD_ADDRESS, LCD_COLS, LCD_ROWS);

// --- Setup Function ---
// Runs once when the Arduino Uno R3 starts.
void setup() {
  // Initialize Serial communication for debugging messages.
  Serial.begin(9600); // Common and reliable baud rate for Arduino Uno.
  Serial.println("Arduino Uno I2C LCD Demo Start");

  // Initialize the I2C bus.
  // For Arduino Uno R3, Wire.begin() implicitly uses A4 (SDA) and A5 (SCL).
  Wire.begin();
  Serial.println("I2C bus initialized for Arduino Uno.");

  // Initialize the LCD.
  lcd.init();
  Serial.println("LCD initialization command sent.");

  // Turn on the LCD backlight.
  lcd.backlight();
  Serial.println("LCD backlight ON.");

  // Define custom characters. There are 8 available custom character locations (0-7).
  // These calls map the byte arrays defined above to specific indices.
  lcd.createChar(0, custom0); // Map 'C'
  lcd.createChar(1, custom1); // Map 'A'
  lcd.createChar(2, custom2); // Map 'L'
  lcd.createChar(3, custom3); // Map ' '
  lcd.createChar(4, custom4); // Map 'B'
  lcd.createChar(5, custom5); // Map 'O'
  lcd.createChar(6, custom6); // Map 'U'
  lcd.createChar(7, custom7); // Map 'N'
  Serial.println("Custom characters created and stored.");

  // Clear the LCD display to ensure a clean start
  lcd.clear();

  // Display initial messages (can be removed if you only want the "Cal bound" message)
  lcd.setCursor(0, 0);
  lcd.print("New Custom Chars!");
  lcd.setCursor(0, 1);
  lcd.print("Ready to display...");
  delay(2000);
  lcd.clear();
}

// --- printMessage Function ---
// Displays a plaintext string on the LCD, handling custom characters.
// Custom characters are embedded in the 'text' string using their byte index.
// For example, '\x00' represents custom character 0, '\x01' for custom character 1, etc.
//
// Parameters:
//   text: The string to display, potentially containing custom character indices (0-7).
//   row: The row (0-indexed) where the text will start.
//   col: The column (0-indexed) where the text will start.
void printMessage(String text, int row, int col) {
  // Set the cursor to the desired starting position
  // Note: LiquidCrystal library uses (column, row) order for setCursor.
  lcd.setCursor(col, row);

  // Iterate through each character in the input string
  for (int i = 0; i < text.length(); i++) {
    char c = text.charAt(i);

    // Check if the character's ASCII value corresponds to a custom character index (0-7)
    // The lcd.write() function is used to print custom characters based on their index.
    if (c >= 0 && c <= 7) {
      lcd.write(c); // Print the custom character at its index (0-7)
    } else {
      lcd.print(c); // Print a normal ASCII character
    }
  }
}

// --- Loop Function ---
// Runs repeatedly after setup() completes.
void loop() {
  // Clear the screen before displaying the new message
  lcd.clear();
  delay(100); // Small delay to ensure clear command is processed

  // --- Displaying "Cal bound" using your custom characters ---
  // '\x00' -> custom character 0 (C)
  // '\x01' -> custom character 1 (A)
  // '\x02' -> custom character 2 (L)
  // '\x03' -> custom character 3 (Space)
  // '\x04' -> custom character 4 (B)
  // '\x05' -> custom character 5 (O)
  // '\x06' -> custom character 6 (U)
  // '\x07' -> custom character 7 (N)
  // 'D'    -> Standard ASCII 'D' (since all 8 custom slots are used)
  printMessage("\x00\x01\x02\x03\x04\x05\x06\x07D", 0, 0); // "CAL BOUND" on row 0
  printMessage("Great Job, Grads!", 1, 0); // Additional message on row 1

  delay(4000); // Display this message for 4 seconds

  // --- You can add your other messages here, using custom or standard chars ---
  lcd.clear();
  delay(100);
  printMessage("CONGRATS Bal grads", 0, 0);
  printMessage("2025!", 1, 0);
  // If you want to use custom chars here, you'd need to know which of your
  // 'custom0' to 'custom7' correspond to 'C', 'O', 'N', etc.
  // For now, these are standard ASCII characters.
  delay(3000);

  lcd.clear();
  delay(100);
  printMessage("BFS 4L", 0, 0);
  printMessage("Go Team!", 1, 0);
  delay(3000);

  // Example: Scrolling text returning to previous demo
  lcd.clear();
  delay(100);
  String scrollText = "   Looping messages... Well done!   ";
  for (int i = 0; i < scrollText.length() - LCD_COLS + 1; i++) {
    printMessage(scrollText.substring(i, i + LCD_COLS), 0, 0);
    delay(200); // Adjust delay for scroll speed
  }
  delay(1000);
}